## baseimage/baseimage_defconfig
```kconfig
BR2_TARGET_ROOTFS_EXT2_SIZE="120M"
BR2_PACKAGE_ZLIB=y
BR2_PACKAGE_OPENSSL=y
BR2_PACKAGE_LIBNL=y
BR2_PACKAGE_IPROUTE2=y
BR2_PACKAGE_IW=y
BR2_PACKAGE_OPENSSH=y
BR2_PACKAGE_WIRELESS_TOOLS=y
BR2_PACKAGE_WPA_SUPPLICANT=y
BR2_PACKAGE_WPA_SUPPLICANT_NL80211=y
BR2_PACKAGE_DHCPCD=y

# GDB
BR2_PACKAGE_GDB=y
BR2_PACKAGE_GDB_SERVER=y
BR2_PACKAGE_GDB_DEBUGGER=y
BR2_PACKAGE_GDB_TUI=y
BR2_PACKAGE_NCURSES=y
```

## cherokee/cherokee_defconfig
```kconfig
BR2_PACKAGE_RPI_WIFI_FIRMWARE=y
BR2_PACKAGE_IPROUTE2=y
BR2_PACKAGE_IW=y
BR2_PACKAGE_OPENSSH=y
BR2_PACKAGE_WIRELESS_TOOLS=y
BR2_PACKAGE_WPA_SUPPLICANT=y
BR2_PACKAGE_WPA_SUPPLICANT_NL80211=y
BR2_PACKAGE_WPA_SUPPLICANT_CLI=y
BR2_PACKAGE_WPA_SUPPLICANT_WPA_CLIENT_SO=y
BR2_PACKAGE_RTL8821AU=y
BR2_PACKAGE_DHCPCD=y
BR2_PACKAGE_WPA_SUPPLICANT_AUTOSCAN=y
BR2_PACKAGE_WPA_SUPPLICANT_DBUS_NEW=y

BR2_INIT_SYSV=y
BR2_ROOTFS_DEVICE_CREATION_DYNAMIC_EUDEV=y
BR2_LINUX_KERNEL_DTS_OVERLAYS_SUPPORT=y

BR2_PACKAGE_RPI_USERLAND=y

BR2_ROOTFS_OVERLAY="../../overlay"
BR2_DL_DIR="../../../dl"
BR2_TARGET_ROOTFS_EXT2_SIZE="380M"
BR2_TARGET_GENERIC_ROOT_PASSWD="navit"

# # Touchscreen
# BR2_LINUX_KERNEL_DTS_OVERLAYS_SUPPORT=y
BR2_PACKAGE_RPI_FIRMWARE_INSTALL_DTB_OVERLAYS=y
# BR2_PACKAGE_RPI_FIRMWARE_INSTALL_VCDBG=y

BR2_ENABLE_LOCALE_PURGE=y
BR2_ENABLE_LOCALE_WHITELIST="C en_US"
BR2_GENERATE_LOCALE="en_US"

BR2_TARGET_TZ_INFO=y
BR2_TARGET_LOCALTIME="America/Los_Angeles"

BR2_PACKAGE_FBV=y
BR2_PACKAGE_FBV_PNG=y
BR2_PACKAGE_FBV_JPEG=y
BR2_PACKAGE_FBV_GIF=y

BR2_PACKAGE_UTIL_LINUX_FSCK=y
BR2_PACKAGE_E2FSPROGS=y
BR2_PACKAGE_E2FSPROGS_RESIZE2FS=y

# BLUETOOTH
BR2_PACKAGE_BLUEZ_TOOLS=y
BR2_PACKAGE_BLUEZ5_UTILS=y
BR2_PACKAGE_BLUEZ5_UTILS_CLIENT=y
BR2_PACKAGE_BLUEZ5_UTILS_DEPRECATED=y
```

## graphics-gtk/graphics-gtk_defconfig
```kconfig
BR2_PACKAGE_NAVIT=y
BR2_PACKAGE_NAVIT_GTK2=y
BR2_PACKAGE_CAIRO=y
BR2_PACKAGE_CAIRO_PS=y
BR2_PACKAGE_CAIRO_PDF=y
BR2_PACKAGE_CAIRO_PNG=y
BR2_PACKAGE_CAIRO_SVG=y
BR2_PACKAGE_GDK_PIXBUF=y
BR2_PACKAGE_LIBGTK2=y
BR2_PACKAGE_LIBPNG=y
BR2_PACKAGE_PANGO=y
BR2_PACKAGE_LIBGLIB2=y
```

## graphics-gtk/package/navit/Config.in
```kconfig
config BR2_PACKAGE_NAVIT
        bool "navit"
        depends on BR2_PACKAGE_GLIBC
        help
          The OpenSource vector based navigation software

          http://www.navit-project.org

if BR2_PACKAGE_NAVIT

config BR2_PACKAGE_NAVIT_GTK2
	bool "enabled GTK2 graphics driver"
	select BR2_PACKAGE_LIBGTK2
	select BR2_PACKAGE_XORG7
	help
	  Enable the gtk2 (gtk_drawing_area) graphics driver

config BR2_PACKAGE_NAVIT_QT5
	bool "enabled QT5 graphics driver"
	help
	  Enable the QT5 (qml2) graphics driver

endif
```

## graphics-qt5/graphics-qt5_defconfig
```kconfig
BR2_PACKAGE_QT5=y
BR2_PACKAGE_QT5_VERSION_LATEST=y
BR2_PACKAGE_QT5BASE=y
BR2_PACKAGE_QT5BASE_CUSTOM_CONF_OPTS=""
BR2_PACKAGE_QT5BASE_LICENSE_APPROVED=y
BR2_PACKAGE_QT5BASE_CONFIG_FILE=""
BR2_PACKAGE_QT5BASE_NETWORK=y
BR2_PACKAGE_QT5BASE_SQL=y
BR2_PACKAGE_QT5BASE_SQLITE_NONE=y
BR2_PACKAGE_QT5BASE_TEST=y
BR2_PACKAGE_QT5BASE_XML=y
BR2_PACKAGE_QT5BASE_GUI=y
BR2_PACKAGE_QT5BASE_LINUXFB=y
BR2_PACKAGE_QT5BASE_DEFAULT_QPA=""
BR2_PACKAGE_QT5DECLARATIVE=y
BR2_PACKAGE_QT5XMLPATTERNS=y
BR2_PACKAGE_NAVIT=y
BR2_PACKAGE_NAVIT_QT5=y
BR2_PACKAGE_ZLIB=y
BR2_PACKAGE_FREETYPE=y
BR2_PACKAGE_PCRE=y
BR2_PACKAGE_PCRE_16=y
BR2_PACKAGE_PCRE_UTF=y
```

## graphics-qt5/package/navit/Config.in
```kconfig
config BR2_PACKAGE_NAVIT
        bool "navit"
        depends on BR2_PACKAGE_GLIBC
        help
          The OpenSource vector based navigation software

          http://www.navit-project.org

if BR2_PACKAGE_NAVIT

config BR2_PACKAGE_NAVIT_GTK2
	bool "enabled GTK2 graphics driver"
	select BR2_PACKAGE_LIBGTK2
	select BR2_PACKAGE_XORG7
	help
	  Enable the gtk2 (gtk_drawing_area) graphics driver

config BR2_PACKAGE_NAVIT_QT5
	bool "enabled QT5 graphics driver"
	select BR2_PACKAGE_QT5SVG
	select BR2_PACKAGE_QT5LOCATION
	select BR2_PACKAGE_QT5BASE_DBUS
	help
	  Enable the QT5 (qml2) graphics driver

endif
```

## packages/libspotify/Config.in
```kconfig
config BR2_PACKAGE_LIBSPOTIFY
        bool "libspotify"
        help
          Libspotify
```

## packages/navit/Config.in
```kconfig
config BR2_PACKAGE_NAVIT
        bool "navit"
        depends on BR2_PACKAGE_GLIBC
        help
          The OpenSource vector based navigation software

          http://www.navit-project.org

if BR2_PACKAGE_NAVIT

config BR2_PACKAGE_NAVIT_GTK2
	bool "enable GTK2 graphics driver"
	select BR2_PACKAGE_LIBGTK2
	select BR2_PACKAGE_XORG7
	help
	  Enable the gtk2 (gtk_drawing_area) graphics driver

config BR2_PACKAGE_NAVIT_QT5
	bool "enable QT5 graphics driver"
	select BR2_PACKAGE_QT5DECLARATIVE
	select BR2_PACKAGE_QT5DECLARATIVE_QUICK
	select BR2_PACKAGE_QT5SVG
	help
	  Enable the QT5 (qml2) graphics driver

config BR2_PACKAGE_NAVIT_SSD1306
	bool "enable ssd1306 graphics driver"
	select BR2_PACKAGE_SSD1306
	help
	  Enable the ssd1306 graphics driver

config BR2_PACKAGE_NAVIT_SPOTIFY_PLAYER
	bool "enabled spotify player"
	select BR2_PACKAGE_ALSA_LIB
	select BR2_PACKAGE_LIBSPOTIFY
	help
	  Enable spotify player and alsa output

config BR2_PACKAGE_NAVIT_J1850_PLUGIN
	bool "enabled the j1850 plugin"
	help
	  Enable the SAE-J1850 plugin

config BR2_PACKAGE_NAVIT_VEHICLE_GPSD
	bool "enabled gpsd vehicle"
	select BR2_PACKAGE_GPSD
	help
	  Enable the GPSD vehicle

endif
```

## packages/ssd1306/Config.in
```kconfig
config BR2_PACKAGE_SSD1306
        bool "ssd1306"
        help
          Hallard's SSD 1306
```

## powertune/powertune_defconfig
```kconfig
BR2_PACKAGE_POWERTUNE=y

BR2_PACKAGE_RPI_WIFI_FIRMWARE=y
BR2_PACKAGE_IPROUTE2=y
BR2_PACKAGE_IW=y
BR2_PACKAGE_OPENSSH=y
BR2_PACKAGE_WIRELESS_TOOLS=y
BR2_PACKAGE_WPA_SUPPLICANT=y
BR2_PACKAGE_WPA_SUPPLICANT_NL80211=y
BR2_PACKAGE_WPA_SUPPLICANT_CLI=y
BR2_PACKAGE_WPA_SUPPLICANT_WPA_CLIENT_SO=y
BR2_PACKAGE_DHCPCD=y
BR2_PACKAGE_WPA_SUPPLICANT_AUTOSCAN=y
BR2_PACKAGE_WPA_SUPPLICANT_DBUS_NEW=y

BR2_INIT_SYSV=y
BR2_ROOTFS_DEVICE_CREATION_DYNAMIC_EUDEV=y
BR2_LINUX_KERNEL_DTS_OVERLAYS_SUPPORT=y

BR2_PACKAGE_RPI_USERLAND=y
BR2_ROOTFS_OVERLAY="../../overlay"

BR2_DL_DIR="../../../dl"
BR2_TARGET_ROOTFS_EXT2_SIZE="513M"
BR2_TARGET_GENERIC_ROOT_PASSWD="root"

# BR2_PACKAGE_I2C_TOOLS=y

BR2_TOOLCHAIN_BUILDROOT_CXX=y

BR2_TARGET_UBOOT_CUSTOM_VERSION_VALUE="2018.07"
```

## speedsaver/navit_defconfig
```kconfig
BR2_PACKAGE_LIBGLIB2=y
BR2_PACKAGE_NAVIT=y
BR2_PACKAGE_SSD1306=y
BR2_PACKAGE_NAVIT_SSD1306=y
BR2_PACKAGE_NAVIT_GPSD_VEHICLE=y
BR2_PACKAGE_NAVIT_VEHICLE_GPSD=y
BR2_PACKAGE_GPSD_DEVICES="/dev/ttyAMA0"
BR2_PACKAGE_GPSD_SIRF=y
```

## toolchain/rpi0-glibc_defconfig
```kconfig
BR2_arm=y
BR2_arm1176jzf_s=y
BR2_ARM_EABIHF=y

# Linux headers same as kernel, a 4.4 series
BR2_PACKAGE_HOST_LINUX_HEADERS_CUSTOM_4_4=y

BR2_TOOLCHAIN_BUILDROOT_CXX=y

BR2_LINUX_KERNEL=y
BR2_LINUX_KERNEL_CUSTOM_GIT=y
BR2_LINUX_KERNEL_CUSTOM_REPO_URL="https://github.com/raspberrypi/linux.git"
BR2_LINUX_KERNEL_CUSTOM_REPO_VERSION="1ebe8d4a4c96cd6a90805c74233a468854960f67"
BR2_LINUX_KERNEL_DEFCONFIG="bcmrpi"

# Build the DTBs for A/B from the kernel sources: the zero is the same
# as the A+ model, just in a different form-factor
BR2_LINUX_KERNEL_DTS_SUPPORT=y
BR2_LINUX_KERNEL_INTREE_DTS_NAME="bcm2708-rpi-b-plus"

BR2_PACKAGE_RPI_FIRMWARE=y
# BR2_PACKAGE_RPI_FIRMWARE_INSTALL_DTB_OVERLAYS is not set

# Required tools to create the SD image
BR2_PACKAGE_HOST_DOSFSTOOLS=y
BR2_PACKAGE_HOST_GENIMAGE=y
BR2_PACKAGE_HOST_MTOOLS=y

# Filesystem / image
BR2_TARGET_ROOTFS_EXT2=y
BR2_TARGET_ROOTFS_EXT2_4=y
# BR2_TARGET_ROOTFS_TAR is not set
BR2_ROOTFS_POST_BUILD_SCRIPT="board/raspberrypi0/post-build.sh"
BR2_ROOTFS_POST_IMAGE_SCRIPT="board/raspberrypi0/post-image.sh"

# Disable getty
# BR2_TARGET_GENERIC_GETTY is not set
# BR2_TARGET_GENERIC_GETTY_BAUDRATE_KEEP is not set

# Glibc based toolchain
BR2_SSP_NONE=y
BR2_TOOLCHAIN_USES_GLIBC=y
BR2_TOOLCHAIN_BUILDROOT_GLIBC=y
BR2_TOOLCHAIN_BUILDROOT_LIBC="glibc"
BR2_PACKAGE_GLIBC=y
BR2_GLIBC_VERSION_2_23=y
BR2_GLIBC_VERSION_STRING="2.23"
BR2_TOOLCHAIN_HAS_NATIVE_RPC=y
BR2_USE_WCHAR=y
BR2_ENABLE_LOCALE=y
BR2_TOOLCHAIN_HAS_THREADS_DEBUG=y
BR2_TOOLCHAIN_HAS_SSP=y
BR2_TOOLCHAIN_ARM_HAS_SYNC_8=y
BR2_TOOLCHAIN_HAS_SYNC_8=y
BR2_GENERATE_LOCALE=""
BR2_PACKAGE_KODI_ARCH_SUPPORTS=y
```

## toolchain/rpi3-glibc_defconfig
```kconfig
BR2_arm=y
BR2_cortex_a7=y
BR2_ARM_EABIHF=y
BR2_ARM_FPU_NEON_VFPV4=y

BR2_TOOLCHAIN_BUILDROOT_CXX=y

BR2_SYSTEM_DHCP="eth0"

# Linux headers same as kernel, a 4.4 series
BR2_PACKAGE_HOST_LINUX_HEADERS_CUSTOM_4_4=y

BR2_LINUX_KERNEL=y
BR2_LINUX_KERNEL_CUSTOM_GIT=y
BR2_LINUX_KERNEL_CUSTOM_REPO_URL="https://github.com/raspberrypi/linux.git"
BR2_LINUX_KERNEL_CUSTOM_REPO_VERSION="1ebe8d4a4c96cd6a90805c74233a468854960f67"
BR2_LINUX_KERNEL_DEFCONFIG="bcm2709"

# Build the DTB from the kernel sources
BR2_LINUX_KERNEL_DTS_SUPPORT=y
BR2_LINUX_KERNEL_INTREE_DTS_NAME="bcm2710-rpi-3-b"

BR2_PACKAGE_RPI_FIRMWARE=y
BR2_PACKAGE_RPI_FIRMWARE_INSTALL_DTB_OVERLAYS=y

# Required tools to create the SD image
BR2_PACKAGE_HOST_DOSFSTOOLS=y
BR2_PACKAGE_HOST_GENIMAGE=y
BR2_PACKAGE_HOST_MTOOLS=y

# Filesystem / image
BR2_TARGET_ROOTFS_EXT2=y
BR2_TARGET_ROOTFS_EXT2_4=y
# BR2_TARGET_ROOTFS_TAR is not set
BR2_ROOTFS_POST_BUILD_SCRIPT="board/raspberrypi3/post-build.sh"
BR2_ROOTFS_POST_IMAGE_SCRIPT="board/raspberrypi3/post-image.sh"
BR2_ROOTFS_POST_SCRIPT_ARGS="--add-pi3-miniuart-bt-overlay"

# Glibc based toolchain
BR2_SSP_NONE=y
BR2_TOOLCHAIN_USES_GLIBC=y
BR2_TOOLCHAIN_BUILDROOT_GLIBC=y
BR2_TOOLCHAIN_BUILDROOT_LIBC="glibc"
BR2_PACKAGE_GLIBC=y
BR2_GLIBC_VERSION_2_23=y
BR2_GLIBC_VERSION_STRING="2.23"
BR2_TOOLCHAIN_HAS_NATIVE_RPC=y
BR2_USE_WCHAR=y
BR2_ENABLE_LOCALE=y
BR2_TOOLCHAIN_HAS_THREADS_DEBUG=y
BR2_TOOLCHAIN_HAS_SSP=y
BR2_GENERATE_LOCALE=""
```
